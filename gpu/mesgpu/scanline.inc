/*
 * Generated using scanline_generator.py
 */
pxs = *(uint32_t *) (line + (0 * BUFFER_BPP));
GPIO_ODR(GPIO_COLOR_PORT) = color_palette[(pxs >> ((7 -0) * BUFFER_BPP)) & PIXEL_MASK];GPIO_ODR(GPIO_COLOR_PORT) = color_palette[(pxs >> ((7 -1) * BUFFER_BPP)) & PIXEL_MASK];GPIO_ODR(GPIO_COLOR_PORT) = color_palette[(pxs >> ((7 -2) * BUFFER_BPP)) & PIXEL_MASK];GPIO_ODR(GPIO_COLOR_PORT) = color_palette[(pxs >> ((7 -3) * BUFFER_BPP)) & PIXEL_MASK];GPIO_ODR(GPIO_COLOR_PORT) = color_palette[(pxs >> ((7 -4) * BUFFER_BPP)) & PIXEL_MASK];GPIO_ODR(GPIO_COLOR_PORT) = color_palette[(pxs >> ((7 -5) * BUFFER_BPP)) & PIXEL_MASK];GPIO_ODR(GPIO_COLOR_PORT) = color_palette[(pxs >> ((7 -6) * BUFFER_BPP)) & PIXEL_MASK];GPIO_ODR(GPIO_COLOR_PORT) = color_palette[(pxs >> ((7 -7) * BUFFER_BPP)) & PIXEL_MASK];
pxs = *(uint32_t *) (line + (1 * BUFFER_BPP));
GPIO_ODR(GPIO_COLOR_PORT) = color_palette[(pxs >> ((7 -0) * BUFFER_BPP)) & PIXEL_MASK];GPIO_ODR(GPIO_COLOR_PORT) = color_palette[(pxs >> ((7 -1) * BUFFER_BPP)) & PIXEL_MASK];GPIO_ODR(GPIO_COLOR_PORT) = color_palette[(pxs >> ((7 -2) * BUFFER_BPP)) & PIXEL_MASK];GPIO_ODR(GPIO_COLOR_PORT) = color_palette[(pxs >> ((7 -3) * BUFFER_BPP)) & PIXEL_MASK];GPIO_ODR(GPIO_COLOR_PORT) = color_palette[(pxs >> ((7 -4) * BUFFER_BPP)) & PIXEL_MASK];GPIO_ODR(GPIO_COLOR_PORT) = color_palette[(pxs >> ((7 -5) * BUFFER_BPP)) & PIXEL_MASK];GPIO_ODR(GPIO_COLOR_PORT) = color_palette[(pxs >> ((7 -6) * BUFFER_BPP)) & PIXEL_MASK];GPIO_ODR(GPIO_COLOR_PORT) = color_palette[(pxs >> ((7 -7) * BUFFER_BPP)) & PIXEL_MASK];
pxs = *(uint32_t *) (line + (2 * BUFFER_BPP));
GPIO_ODR(GPIO_COLOR_PORT) = color_palette[(pxs >> ((7 -0) * BUFFER_BPP)) & PIXEL_MASK];GPIO_ODR(GPIO_COLOR_PORT) = color_palette[(pxs >> ((7 -1) * BUFFER_BPP)) & PIXEL_MASK];GPIO_ODR(GPIO_COLOR_PORT) = color_palette[(pxs >> ((7 -2) * BUFFER_BPP)) & PIXEL_MASK];GPIO_ODR(GPIO_COLOR_PORT) = color_palette[(pxs >> ((7 -3) * BUFFER_BPP)) & PIXEL_MASK];GPIO_ODR(GPIO_COLOR_PORT) = color_palette[(pxs >> ((7 -4) * BUFFER_BPP)) & PIXEL_MASK];GPIO_ODR(GPIO_COLOR_PORT) = color_palette[(pxs >> ((7 -5) * BUFFER_BPP)) & PIXEL_MASK];GPIO_ODR(GPIO_COLOR_PORT) = color_palette[(pxs >> ((7 -6) * BUFFER_BPP)) & PIXEL_MASK];GPIO_ODR(GPIO_COLOR_PORT) = color_palette[(pxs >> ((7 -7) * BUFFER_BPP)) & PIXEL_MASK];
pxs = *(uint32_t *) (line + (3 * BUFFER_BPP));
GPIO_ODR(GPIO_COLOR_PORT) = color_palette[(pxs >> ((7 -0) * BUFFER_BPP)) & PIXEL_MASK];GPIO_ODR(GPIO_COLOR_PORT) = color_palette[(pxs >> ((7 -1) * BUFFER_BPP)) & PIXEL_MASK];GPIO_ODR(GPIO_COLOR_PORT) = color_palette[(pxs >> ((7 -2) * BUFFER_BPP)) & PIXEL_MASK];GPIO_ODR(GPIO_COLOR_PORT) = color_palette[(pxs >> ((7 -3) * BUFFER_BPP)) & PIXEL_MASK];GPIO_ODR(GPIO_COLOR_PORT) = color_palette[(pxs >> ((7 -4) * BUFFER_BPP)) & PIXEL_MASK];GPIO_ODR(GPIO_COLOR_PORT) = color_palette[(pxs >> ((7 -5) * BUFFER_BPP)) & PIXEL_MASK];GPIO_ODR(GPIO_COLOR_PORT) = color_palette[(pxs >> ((7 -6) * BUFFER_BPP)) & PIXEL_MASK];GPIO_ODR(GPIO_COLOR_PORT) = color_palette[(pxs >> ((7 -7) * BUFFER_BPP)) & PIXEL_MASK];
pxs = *(uint32_t *) (line + (4 * BUFFER_BPP));
GPIO_ODR(GPIO_COLOR_PORT) = color_palette[(pxs >> ((7 -0) * BUFFER_BPP)) & PIXEL_MASK];GPIO_ODR(GPIO_COLOR_PORT) = color_palette[(pxs >> ((7 -1) * BUFFER_BPP)) & PIXEL_MASK];GPIO_ODR(GPIO_COLOR_PORT) = color_palette[(pxs >> ((7 -2) * BUFFER_BPP)) & PIXEL_MASK];GPIO_ODR(GPIO_COLOR_PORT) = color_palette[(pxs >> ((7 -3) * BUFFER_BPP)) & PIXEL_MASK];GPIO_ODR(GPIO_COLOR_PORT) = color_palette[(pxs >> ((7 -4) * BUFFER_BPP)) & PIXEL_MASK];GPIO_ODR(GPIO_COLOR_PORT) = color_palette[(pxs >> ((7 -5) * BUFFER_BPP)) & PIXEL_MASK];GPIO_ODR(GPIO_COLOR_PORT) = color_palette[(pxs >> ((7 -6) * BUFFER_BPP)) & PIXEL_MASK];GPIO_ODR(GPIO_COLOR_PORT) = color_palette[(pxs >> ((7 -7) * BUFFER_BPP)) & PIXEL_MASK];
pxs = *(uint32_t *) (line + (5 * BUFFER_BPP));
GPIO_ODR(GPIO_COLOR_PORT) = color_palette[(pxs >> ((7 -0) * BUFFER_BPP)) & PIXEL_MASK];GPIO_ODR(GPIO_COLOR_PORT) = color_palette[(pxs >> ((7 -1) * BUFFER_BPP)) & PIXEL_MASK];GPIO_ODR(GPIO_COLOR_PORT) = color_palette[(pxs >> ((7 -2) * BUFFER_BPP)) & PIXEL_MASK];GPIO_ODR(GPIO_COLOR_PORT) = color_palette[(pxs >> ((7 -3) * BUFFER_BPP)) & PIXEL_MASK];GPIO_ODR(GPIO_COLOR_PORT) = color_palette[(pxs >> ((7 -4) * BUFFER_BPP)) & PIXEL_MASK];GPIO_ODR(GPIO_COLOR_PORT) = color_palette[(pxs >> ((7 -5) * BUFFER_BPP)) & PIXEL_MASK];GPIO_ODR(GPIO_COLOR_PORT) = color_palette[(pxs >> ((7 -6) * BUFFER_BPP)) & PIXEL_MASK];GPIO_ODR(GPIO_COLOR_PORT) = color_palette[(pxs >> ((7 -7) * BUFFER_BPP)) & PIXEL_MASK];
pxs = *(uint32_t *) (line + (6 * BUFFER_BPP));
GPIO_ODR(GPIO_COLOR_PORT) = color_palette[(pxs >> ((7 -0) * BUFFER_BPP)) & PIXEL_MASK];GPIO_ODR(GPIO_COLOR_PORT) = color_palette[(pxs >> ((7 -1) * BUFFER_BPP)) & PIXEL_MASK];GPIO_ODR(GPIO_COLOR_PORT) = color_palette[(pxs >> ((7 -2) * BUFFER_BPP)) & PIXEL_MASK];GPIO_ODR(GPIO_COLOR_PORT) = color_palette[(pxs >> ((7 -3) * BUFFER_BPP)) & PIXEL_MASK];GPIO_ODR(GPIO_COLOR_PORT) = color_palette[(pxs >> ((7 -4) * BUFFER_BPP)) & PIXEL_MASK];GPIO_ODR(GPIO_COLOR_PORT) = color_palette[(pxs >> ((7 -5) * BUFFER_BPP)) & PIXEL_MASK];GPIO_ODR(GPIO_COLOR_PORT) = color_palette[(pxs >> ((7 -6) * BUFFER_BPP)) & PIXEL_MASK];GPIO_ODR(GPIO_COLOR_PORT) = color_palette[(pxs >> ((7 -7) * BUFFER_BPP)) & PIXEL_MASK];
pxs = *(uint32_t *) (line + (7 * BUFFER_BPP));
GPIO_ODR(GPIO_COLOR_PORT) = color_palette[(pxs >> ((7 -0) * BUFFER_BPP)) & PIXEL_MASK];GPIO_ODR(GPIO_COLOR_PORT) = color_palette[(pxs >> ((7 -1) * BUFFER_BPP)) & PIXEL_MASK];GPIO_ODR(GPIO_COLOR_PORT) = color_palette[(pxs >> ((7 -2) * BUFFER_BPP)) & PIXEL_MASK];GPIO_ODR(GPIO_COLOR_PORT) = color_palette[(pxs >> ((7 -3) * BUFFER_BPP)) & PIXEL_MASK];GPIO_ODR(GPIO_COLOR_PORT) = color_palette[(pxs >> ((7 -4) * BUFFER_BPP)) & PIXEL_MASK];GPIO_ODR(GPIO_COLOR_PORT) = color_palette[(pxs >> ((7 -5) * BUFFER_BPP)) & PIXEL_MASK];GPIO_ODR(GPIO_COLOR_PORT) = color_palette[(pxs >> ((7 -6) * BUFFER_BPP)) & PIXEL_MASK];GPIO_ODR(GPIO_COLOR_PORT) = color_palette[(pxs >> ((7 -7) * BUFFER_BPP)) & PIXEL_MASK];
pxs = *(uint32_t *) (line + (8 * BUFFER_BPP));
GPIO_ODR(GPIO_COLOR_PORT) = color_palette[(pxs >> ((7 -0) * BUFFER_BPP)) & PIXEL_MASK];GPIO_ODR(GPIO_COLOR_PORT) = color_palette[(pxs >> ((7 -1) * BUFFER_BPP)) & PIXEL_MASK];GPIO_ODR(GPIO_COLOR_PORT) = color_palette[(pxs >> ((7 -2) * BUFFER_BPP)) & PIXEL_MASK];GPIO_ODR(GPIO_COLOR_PORT) = color_palette[(pxs >> ((7 -3) * BUFFER_BPP)) & PIXEL_MASK];GPIO_ODR(GPIO_COLOR_PORT) = color_palette[(pxs >> ((7 -4) * BUFFER_BPP)) & PIXEL_MASK];GPIO_ODR(GPIO_COLOR_PORT) = color_palette[(pxs >> ((7 -5) * BUFFER_BPP)) & PIXEL_MASK];GPIO_ODR(GPIO_COLOR_PORT) = color_palette[(pxs >> ((7 -6) * BUFFER_BPP)) & PIXEL_MASK];GPIO_ODR(GPIO_COLOR_PORT) = color_palette[(pxs >> ((7 -7) * BUFFER_BPP)) & PIXEL_MASK];
pxs = *(uint32_t *) (line + (9 * BUFFER_BPP));
GPIO_ODR(GPIO_COLOR_PORT) = color_palette[(pxs >> ((7 -0) * BUFFER_BPP)) & PIXEL_MASK];GPIO_ODR(GPIO_COLOR_PORT) = color_palette[(pxs >> ((7 -1) * BUFFER_BPP)) & PIXEL_MASK];GPIO_ODR(GPIO_COLOR_PORT) = color_palette[(pxs >> ((7 -2) * BUFFER_BPP)) & PIXEL_MASK];GPIO_ODR(GPIO_COLOR_PORT) = color_palette[(pxs >> ((7 -3) * BUFFER_BPP)) & PIXEL_MASK];GPIO_ODR(GPIO_COLOR_PORT) = color_palette[(pxs >> ((7 -4) * BUFFER_BPP)) & PIXEL_MASK];GPIO_ODR(GPIO_COLOR_PORT) = color_palette[(pxs >> ((7 -5) * BUFFER_BPP)) & PIXEL_MASK];GPIO_ODR(GPIO_COLOR_PORT) = color_palette[(pxs >> ((7 -6) * BUFFER_BPP)) & PIXEL_MASK];GPIO_ODR(GPIO_COLOR_PORT) = color_palette[(pxs >> ((7 -7) * BUFFER_BPP)) & PIXEL_MASK];
pxs = *(uint32_t *) (line + (10 * BUFFER_BPP));
GPIO_ODR(GPIO_COLOR_PORT) = color_palette[(pxs >> ((7 -0) * BUFFER_BPP)) & PIXEL_MASK];GPIO_ODR(GPIO_COLOR_PORT) = color_palette[(pxs >> ((7 -1) * BUFFER_BPP)) & PIXEL_MASK];GPIO_ODR(GPIO_COLOR_PORT) = color_palette[(pxs >> ((7 -2) * BUFFER_BPP)) & PIXEL_MASK];GPIO_ODR(GPIO_COLOR_PORT) = color_palette[(pxs >> ((7 -3) * BUFFER_BPP)) & PIXEL_MASK];GPIO_ODR(GPIO_COLOR_PORT) = color_palette[(pxs >> ((7 -4) * BUFFER_BPP)) & PIXEL_MASK];GPIO_ODR(GPIO_COLOR_PORT) = color_palette[(pxs >> ((7 -5) * BUFFER_BPP)) & PIXEL_MASK];GPIO_ODR(GPIO_COLOR_PORT) = color_palette[(pxs >> ((7 -6) * BUFFER_BPP)) & PIXEL_MASK];GPIO_ODR(GPIO_COLOR_PORT) = color_palette[(pxs >> ((7 -7) * BUFFER_BPP)) & PIXEL_MASK];
pxs = *(uint32_t *) (line + (11 * BUFFER_BPP));
GPIO_ODR(GPIO_COLOR_PORT) = color_palette[(pxs >> ((7 -0) * BUFFER_BPP)) & PIXEL_MASK];GPIO_ODR(GPIO_COLOR_PORT) = color_palette[(pxs >> ((7 -1) * BUFFER_BPP)) & PIXEL_MASK];GPIO_ODR(GPIO_COLOR_PORT) = color_palette[(pxs >> ((7 -2) * BUFFER_BPP)) & PIXEL_MASK];GPIO_ODR(GPIO_COLOR_PORT) = color_palette[(pxs >> ((7 -3) * BUFFER_BPP)) & PIXEL_MASK];GPIO_ODR(GPIO_COLOR_PORT) = color_palette[(pxs >> ((7 -4) * BUFFER_BPP)) & PIXEL_MASK];GPIO_ODR(GPIO_COLOR_PORT) = color_palette[(pxs >> ((7 -5) * BUFFER_BPP)) & PIXEL_MASK];GPIO_ODR(GPIO_COLOR_PORT) = color_palette[(pxs >> ((7 -6) * BUFFER_BPP)) & PIXEL_MASK];GPIO_ODR(GPIO_COLOR_PORT) = color_palette[(pxs >> ((7 -7) * BUFFER_BPP)) & PIXEL_MASK];
pxs = *(uint32_t *) (line + (12 * BUFFER_BPP));
GPIO_ODR(GPIO_COLOR_PORT) = color_palette[(pxs >> ((7 -0) * BUFFER_BPP)) & PIXEL_MASK];GPIO_ODR(GPIO_COLOR_PORT) = color_palette[(pxs >> ((7 -1) * BUFFER_BPP)) & PIXEL_MASK];GPIO_ODR(GPIO_COLOR_PORT) = color_palette[(pxs >> ((7 -2) * BUFFER_BPP)) & PIXEL_MASK];GPIO_ODR(GPIO_COLOR_PORT) = color_palette[(pxs >> ((7 -3) * BUFFER_BPP)) & PIXEL_MASK];GPIO_ODR(GPIO_COLOR_PORT) = color_palette[(pxs >> ((7 -4) * BUFFER_BPP)) & PIXEL_MASK];GPIO_ODR(GPIO_COLOR_PORT) = color_palette[(pxs >> ((7 -5) * BUFFER_BPP)) & PIXEL_MASK];GPIO_ODR(GPIO_COLOR_PORT) = color_palette[(pxs >> ((7 -6) * BUFFER_BPP)) & PIXEL_MASK];GPIO_ODR(GPIO_COLOR_PORT) = color_palette[(pxs >> ((7 -7) * BUFFER_BPP)) & PIXEL_MASK];
pxs = *(uint32_t *) (line + (13 * BUFFER_BPP));
GPIO_ODR(GPIO_COLOR_PORT) = color_palette[(pxs >> ((7 -0) * BUFFER_BPP)) & PIXEL_MASK];GPIO_ODR(GPIO_COLOR_PORT) = color_palette[(pxs >> ((7 -1) * BUFFER_BPP)) & PIXEL_MASK];GPIO_ODR(GPIO_COLOR_PORT) = color_palette[(pxs >> ((7 -2) * BUFFER_BPP)) & PIXEL_MASK];GPIO_ODR(GPIO_COLOR_PORT) = color_palette[(pxs >> ((7 -3) * BUFFER_BPP)) & PIXEL_MASK];GPIO_ODR(GPIO_COLOR_PORT) = color_palette[(pxs >> ((7 -4) * BUFFER_BPP)) & PIXEL_MASK];GPIO_ODR(GPIO_COLOR_PORT) = color_palette[(pxs >> ((7 -5) * BUFFER_BPP)) & PIXEL_MASK];GPIO_ODR(GPIO_COLOR_PORT) = color_palette[(pxs >> ((7 -6) * BUFFER_BPP)) & PIXEL_MASK];GPIO_ODR(GPIO_COLOR_PORT) = color_palette[(pxs >> ((7 -7) * BUFFER_BPP)) & PIXEL_MASK];
pxs = *(uint32_t *) (line + (14 * BUFFER_BPP));
GPIO_ODR(GPIO_COLOR_PORT) = color_palette[(pxs >> ((7 -0) * BUFFER_BPP)) & PIXEL_MASK];GPIO_ODR(GPIO_COLOR_PORT) = color_palette[(pxs >> ((7 -1) * BUFFER_BPP)) & PIXEL_MASK];GPIO_ODR(GPIO_COLOR_PORT) = color_palette[(pxs >> ((7 -2) * BUFFER_BPP)) & PIXEL_MASK];GPIO_ODR(GPIO_COLOR_PORT) = color_palette[(pxs >> ((7 -3) * BUFFER_BPP)) & PIXEL_MASK];GPIO_ODR(GPIO_COLOR_PORT) = color_palette[(pxs >> ((7 -4) * BUFFER_BPP)) & PIXEL_MASK];GPIO_ODR(GPIO_COLOR_PORT) = color_palette[(pxs >> ((7 -5) * BUFFER_BPP)) & PIXEL_MASK];GPIO_ODR(GPIO_COLOR_PORT) = color_palette[(pxs >> ((7 -6) * BUFFER_BPP)) & PIXEL_MASK];GPIO_ODR(GPIO_COLOR_PORT) = color_palette[(pxs >> ((7 -7) * BUFFER_BPP)) & PIXEL_MASK];
pxs = *(uint32_t *) (line + (15 * BUFFER_BPP));
GPIO_ODR(GPIO_COLOR_PORT) = color_palette[(pxs >> ((7 -0) * BUFFER_BPP)) & PIXEL_MASK];GPIO_ODR(GPIO_COLOR_PORT) = color_palette[(pxs >> ((7 -1) * BUFFER_BPP)) & PIXEL_MASK];GPIO_ODR(GPIO_COLOR_PORT) = color_palette[(pxs >> ((7 -2) * BUFFER_BPP)) & PIXEL_MASK];GPIO_ODR(GPIO_COLOR_PORT) = color_palette[(pxs >> ((7 -3) * BUFFER_BPP)) & PIXEL_MASK];GPIO_ODR(GPIO_COLOR_PORT) = color_palette[(pxs >> ((7 -4) * BUFFER_BPP)) & PIXEL_MASK];GPIO_ODR(GPIO_COLOR_PORT) = color_palette[(pxs >> ((7 -5) * BUFFER_BPP)) & PIXEL_MASK];GPIO_ODR(GPIO_COLOR_PORT) = color_palette[(pxs >> ((7 -6) * BUFFER_BPP)) & PIXEL_MASK];GPIO_ODR(GPIO_COLOR_PORT) = color_palette[(pxs >> ((7 -7) * BUFFER_BPP)) & PIXEL_MASK];
pxs = *(uint32_t *) (line + (16 * BUFFER_BPP));
GPIO_ODR(GPIO_COLOR_PORT) = color_palette[(pxs >> ((7 -0) * BUFFER_BPP)) & PIXEL_MASK];GPIO_ODR(GPIO_COLOR_PORT) = color_palette[(pxs >> ((7 -1) * BUFFER_BPP)) & PIXEL_MASK];GPIO_ODR(GPIO_COLOR_PORT) = color_palette[(pxs >> ((7 -2) * BUFFER_BPP)) & PIXEL_MASK];GPIO_ODR(GPIO_COLOR_PORT) = color_palette[(pxs >> ((7 -3) * BUFFER_BPP)) & PIXEL_MASK];GPIO_ODR(GPIO_COLOR_PORT) = color_palette[(pxs >> ((7 -4) * BUFFER_BPP)) & PIXEL_MASK];GPIO_ODR(GPIO_COLOR_PORT) = color_palette[(pxs >> ((7 -5) * BUFFER_BPP)) & PIXEL_MASK];GPIO_ODR(GPIO_COLOR_PORT) = color_palette[(pxs >> ((7 -6) * BUFFER_BPP)) & PIXEL_MASK];GPIO_ODR(GPIO_COLOR_PORT) = color_palette[(pxs >> ((7 -7) * BUFFER_BPP)) & PIXEL_MASK];
pxs = *(uint32_t *) (line + (17 * BUFFER_BPP));
GPIO_ODR(GPIO_COLOR_PORT) = color_palette[(pxs >> ((7 -0) * BUFFER_BPP)) & PIXEL_MASK];GPIO_ODR(GPIO_COLOR_PORT) = color_palette[(pxs >> ((7 -1) * BUFFER_BPP)) & PIXEL_MASK];GPIO_ODR(GPIO_COLOR_PORT) = color_palette[(pxs >> ((7 -2) * BUFFER_BPP)) & PIXEL_MASK];GPIO_ODR(GPIO_COLOR_PORT) = color_palette[(pxs >> ((7 -3) * BUFFER_BPP)) & PIXEL_MASK];GPIO_ODR(GPIO_COLOR_PORT) = color_palette[(pxs >> ((7 -4) * BUFFER_BPP)) & PIXEL_MASK];GPIO_ODR(GPIO_COLOR_PORT) = color_palette[(pxs >> ((7 -5) * BUFFER_BPP)) & PIXEL_MASK];GPIO_ODR(GPIO_COLOR_PORT) = color_palette[(pxs >> ((7 -6) * BUFFER_BPP)) & PIXEL_MASK];GPIO_ODR(GPIO_COLOR_PORT) = color_palette[(pxs >> ((7 -7) * BUFFER_BPP)) & PIXEL_MASK];
pxs = *(uint32_t *) (line + (18 * BUFFER_BPP));
GPIO_ODR(GPIO_COLOR_PORT) = color_palette[(pxs >> ((7 -0) * BUFFER_BPP)) & PIXEL_MASK];GPIO_ODR(GPIO_COLOR_PORT) = color_palette[(pxs >> ((7 -1) * BUFFER_BPP)) & PIXEL_MASK];GPIO_ODR(GPIO_COLOR_PORT) = color_palette[(pxs >> ((7 -2) * BUFFER_BPP)) & PIXEL_MASK];GPIO_ODR(GPIO_COLOR_PORT) = color_palette[(pxs >> ((7 -3) * BUFFER_BPP)) & PIXEL_MASK];GPIO_ODR(GPIO_COLOR_PORT) = color_palette[(pxs >> ((7 -4) * BUFFER_BPP)) & PIXEL_MASK];GPIO_ODR(GPIO_COLOR_PORT) = color_palette[(pxs >> ((7 -5) * BUFFER_BPP)) & PIXEL_MASK];GPIO_ODR(GPIO_COLOR_PORT) = color_palette[(pxs >> ((7 -6) * BUFFER_BPP)) & PIXEL_MASK];GPIO_ODR(GPIO_COLOR_PORT) = color_palette[(pxs >> ((7 -7) * BUFFER_BPP)) & PIXEL_MASK];
pxs = *(uint32_t *) (line + (19 * BUFFER_BPP));
GPIO_ODR(GPIO_COLOR_PORT) = color_palette[(pxs >> ((7 -0) * BUFFER_BPP)) & PIXEL_MASK];GPIO_ODR(GPIO_COLOR_PORT) = color_palette[(pxs >> ((7 -1) * BUFFER_BPP)) & PIXEL_MASK];GPIO_ODR(GPIO_COLOR_PORT) = color_palette[(pxs >> ((7 -2) * BUFFER_BPP)) & PIXEL_MASK];GPIO_ODR(GPIO_COLOR_PORT) = color_palette[(pxs >> ((7 -3) * BUFFER_BPP)) & PIXEL_MASK];GPIO_ODR(GPIO_COLOR_PORT) = color_palette[(pxs >> ((7 -4) * BUFFER_BPP)) & PIXEL_MASK];GPIO_ODR(GPIO_COLOR_PORT) = color_palette[(pxs >> ((7 -5) * BUFFER_BPP)) & PIXEL_MASK];GPIO_ODR(GPIO_COLOR_PORT) = color_palette[(pxs >> ((7 -6) * BUFFER_BPP)) & PIXEL_MASK];GPIO_ODR(GPIO_COLOR_PORT) = color_palette[(pxs >> ((7 -7) * BUFFER_BPP)) & PIXEL_MASK];
